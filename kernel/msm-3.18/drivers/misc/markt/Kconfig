## kernel/msm-3.18/sound/soc/codecs/ti/Kconfig
```kconfig
menuconfig SND_SOC_TI_AMP
	tristate "Texas Instruments TAS2559 SmartAmp(R)"

config SND_SOC_TAS2559
	bool "Codec Driver support"

if SND_SOC_TAS2559
config TAS2559_CODEC
    bool "Codec Driver support"

config TAS2559_MISC
    bool "Misc Driver support"
	
endif # SND_SOC_TAS2559

config SND_SOC_TAS5782
	bool "Codec Driver support"
```
