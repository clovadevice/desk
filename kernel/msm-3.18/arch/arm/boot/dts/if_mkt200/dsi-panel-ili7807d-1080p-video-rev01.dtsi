/* Copyright (c) 2013, The Linux Foundation. All rights reserved.
 *
 * This program is free software; you can redistribute it and/or modify
 * it under the terms of the GNU General Public License version 2 and
 * only version 2 as published by the Free Software Foundation.
 *
 * This program is distributed in the hope that it will be useful,
 * but WITHOUT ANY WARRANTY; without even the implied warranty of
 * MERCHANTABILITY or FITNESS FOR A PARTICULAR PURPOSE.  See the
 * GNU General Public License for more details.
 */

/*---------------------------------------------------------------------------
 * This file is autogenerated file using gcdb parser. Please do not edit it.
 * Update input XML file to add a new entry or update variable in this file
 * VERSION = "1.0"
 *---------------------------------------------------------------------------*/
&mdss_mdp {
	dsi_ili7807d_1080p_video_rev01: qcom,mdss_dsi_ili7807d_1080p_video_rev01 {
		qcom,mdss-dsi-panel-name = "ili7807d 1080p video mode dsi panel rev01";
		qcom,mdss-dsi-panel-controller = <&mdss_dsi0>;
		qcom,mdss-dsi-panel-type = "dsi_video_mode";
		qcom,mdss-dsi-panel-destination = "display_1";
		qcom,mdss-dsi-panel-framerate = <60>;
		qcom,mdss-dsi-virtual-channel-id = <0>;
		qcom,mdss-dsi-stream = <0>;
		qcom,mdss-dsi-panel-width = <1080>;
		qcom,mdss-dsi-panel-height = <1920>;
		qcom,mdss-dsi-h-front-porch = <50>;
		qcom,mdss-dsi-h-back-porch = <30>;
		qcom,mdss-dsi-h-pulse-width = <10>;
		qcom,mdss-dsi-h-sync-skew = <0>;
		qcom,mdss-dsi-v-back-porch = <8>;
		qcom,mdss-dsi-v-front-porch = <8>;
		qcom,mdss-dsi-v-pulse-width = <2>;
		qcom,mdss-dsi-h-left-border = <0>;
		qcom,mdss-dsi-h-right-border = <0>;
		qcom,mdss-dsi-v-top-border = <0>;
		qcom,mdss-dsi-v-bottom-border = <0>;
		qcom,mdss-dsi-bpp = <24>;
		qcom,mdss-dsi-color-order = "rgb_swap_rgb";
		qcom,mdss-dsi-underflow-color = <0xff>;
		qcom,mdss-dsi-border-color = <0>;
		qcom,mdss-dsi-on-command = [39 01 00 00 00 00 04 FF 78 07 06
				15 01 00 00 00 00 02 00 42
				15 01 00 00 00 00 02 01 16
				15 01 00 00 00 00 02 02 6A
				15 01 00 00 00 00 02 03 20
				15 01 00 00 00 00 02 04 c6
				15 01 00 00 00 00 02 05 00
				15 01 00 00 00 00 02 06 00
				15 01 00 00 00 00 02 07 00
				15 01 00 00 00 00 02 08 81
				15 01 00 00 00 00 02 09 00
				15 01 00 00 00 00 02 0a 30
				15 01 00 00 00 00 02 0b 00
				15 01 00 00 00 00 02 0c 00
				15 01 00 00 00 00 02 0d 00
				15 01 00 00 00 00 02 0e 11
				15 01 00 00 00 00 02 0f 11
				15 01 00 00 00 00 02 10 00
				15 01 00 00 00 00 02 11 00
				15 01 00 00 00 00 02 12 00
				15 01 00 00 00 00 02 13 00
				15 01 00 00 00 00 02 14 85
				15 01 00 00 00 00 02 15 85
				15 01 00 00 00 00 02 16 00
				15 01 00 00 00 00 02 17 00
				15 01 00 00 00 00 02 18 00
				15 01 00 00 00 00 02 19 00
				15 01 00 00 00 00 02 1a 00
				15 01 00 00 00 00 02 1b 00
				15 01 00 00 00 00 02 1c 00
				15 01 00 00 00 00 02 1d 00
				15 01 00 00 00 00 02 1e 00
				15 01 00 00 00 00 02 1f 00
				15 01 00 00 00 00 02 20 00
				15 01 00 00 00 00 02 21 00
				15 01 00 00 00 00 02 22 00
				15 01 00 00 00 00 02 23 00
				15 01 00 00 00 00 02 24 90
				15 01 00 00 00 00 02 25 06
				15 01 00 00 00 00 02 26 00
				15 01 00 00 00 00 02 27 0c
				15 01 00 00 00 00 02 28 00
				15 01 00 00 00 00 02 29 00
				15 01 00 00 00 00 02 2a 00
				15 01 00 00 00 00 02 2b 00
				15 01 00 00 00 00 02 2c 00
				15 01 00 00 00 00 02 2d 00
				15 01 00 00 00 00 02 2e 00
				15 01 00 00 00 00 02 2f 00
				15 01 00 00 00 00 02 30 00
				15 01 00 00 00 00 02 31 02
				15 01 00 00 00 00 02 32 12
				15 01 00 00 00 00 02 33 10
				15 01 00 00 00 00 02 34 27
				15 01 00 00 00 00 02 35 00
				15 01 00 00 00 00 02 36 01
				15 01 00 00 00 00 02 37 08
				15 01 00 00 00 00 02 38 02
				15 01 00 00 00 00 02 39 02
				15 01 00 00 00 00 02 3a 02
				15 01 00 00 00 00 02 3b 02
				15 01 00 00 00 00 02 3c 02
				15 01 00 00 00 00 02 3d 02
				15 01 00 00 00 00 02 3e 2a
				15 01 00 00 00 00 02 3f 29
				15 01 00 00 00 00 02 40 28
				15 01 00 00 00 00 02 41 02
				15 01 00 00 00 00 02 42 13
				15 01 00 00 00 00 02 43 11
				15 01 00 00 00 00 02 44 27
				15 01 00 00 00 00 02 45 00
				15 01 00 00 00 00 02 46 01
				15 01 00 00 00 00 02 47 09
				15 01 00 00 00 00 02 48 02
				15 01 00 00 00 00 02 49 02
				15 01 00 00 00 00 02 4a 02
				15 01 00 00 00 00 02 4b 02
				15 01 00 00 00 00 02 4c 02
				15 01 00 00 00 00 02 4d 02
				15 01 00 00 00 00 02 4e 2a
				15 01 00 00 00 00 02 4f 29
				15 01 00 00 00 00 02 50 28
				15 01 00 00 00 00 02 60 00
				15 01 00 00 00 00 02 61 02
				15 01 00 00 00 00 02 62 11
				15 01 00 00 00 00 02 63 13
				15 01 00 00 00 00 02 64 27
				15 01 00 00 00 00 02 65 00
				15 01 00 00 00 00 02 66 01
				15 01 00 00 00 00 02 67 09
				15 01 00 00 00 00 02 68 02
				15 01 00 00 00 00 02 69 02
				15 01 00 00 00 00 02 6a 02
				15 01 00 00 00 00 02 6b 02
				15 01 00 00 00 00 02 6c 02
				15 01 00 00 00 00 02 6d 02
				15 01 00 00 00 00 02 6e 2a
				15 01 00 00 00 00 02 6f 29
				15 01 00 00 00 00 02 70 28
				15 01 00 00 00 00 02 71 02
				15 01 00 00 00 00 02 72 10
				15 01 00 00 00 00 02 73 12
				15 01 00 00 00 00 02 74 27
				15 01 00 00 00 00 02 75 00
				15 01 00 00 00 00 02 76 01
				15 01 00 00 00 00 02 77 08
				15 01 00 00 00 00 02 78 02
				15 01 00 00 00 00 02 79 02
				15 01 00 00 00 00 02 7a 02
				15 01 00 00 00 00 02 7b 02
				15 01 00 00 00 00 02 7c 02
				15 01 00 00 00 00 02 7d 02
				15 01 00 00 00 00 02 7e 2a
				15 01 00 00 00 00 02 7f 29
				15 01 00 00 00 00 02 80 28
				15 01 00 00 00 00 02 97 11
				15 01 00 00 00 00 02 d0 01
				15 01 00 00 00 00 02 d1 01
				15 01 00 00 00 00 02 d2 00
				15 01 00 00 00 00 02 d3 11
				15 01 00 00 00 00 02 d4 13
				15 01 00 00 00 00 02 d5 00
				15 01 00 00 00 00 02 d6 00
				15 01 00 00 00 00 02 d7 00
				15 01 00 00 00 00 02 d8 00
				15 01 00 00 00 00 02 d9 00
				15 01 00 00 00 00 02 da 00
				15 01 00 00 00 00 02 db 57
				15 01 00 00 00 00 02 dc 04
				15 01 00 00 00 00 02 dd 55
				15 01 00 00 00 00 02 de 02
				15 01 00 00 00 00 02 e5 80
				15 01 00 00 00 00 02 a0 07
				15 01 00 00 00 00 02 a2 06
				15 01 00 00 00 00 02 a3 1E
				15 01 00 00 00 00 02 a6 20
				15 01 00 00 00 00 02 B2 00
				15 01 00 00 00 00 02 B3 00
				39 01 00 00 00 00 04 FF 78 07 01
				15 01 00 00 00 00 02 42 21
				15 01 00 00 00 00 02 43 a8
				15 01 00 00 00 00 02 44 B2
				15 01 00 00 00 00 02 45 1F
				15 01 00 00 00 00 02 46 1F
				15 01 00 00 00 00 02 4A 05
				15 01 00 00 00 00 02 4B 05
				15 01 00 00 00 00 02 50 6E
				15 01 00 00 00 00 02 51 6E
				15 01 00 00 00 00 02 B3 70
				15 01 00 00 00 00 02 B4 70
				15 01 00 00 00 00 02 A0 50
				15 01 00 00 00 00 02 A2 01
				15 01 00 00 00 00 02 A3 21
				15 01 00 00 00 00 02 22 06
				15 01 00 00 00 00 02 36 00
				15 01 00 00 00 00 02 64 08
				15 01 00 00 00 00 02 65 00
				15 01 00 00 00 00 02 66 04
				15 01 00 00 00 00 02 6C 45
				15 01 00 00 00 00 02 6D 09
				39 01 00 00 00 00 04 FF 78 07 02
				15 01 00 00 00 00 02 00 00
				15 01 00 00 00 00 02 01 00
				15 01 00 00 00 00 02 02 00
				15 01 00 00 00 00 02 03 16
				15 01 00 00 00 00 02 04 00
				15 01 00 00 00 00 02 05 3B
				15 01 00 00 00 00 02 06 00
				15 01 00 00 00 00 02 07 59
				15 01 00 00 00 00 02 08 00
				15 01 00 00 00 00 02 09 74
				15 01 00 00 00 00 02 0A 00
				15 01 00 00 00 00 02 0B 8A
				15 01 00 00 00 00 02 0C 00
				15 01 00 00 00 00 02 0D 9F
				15 01 00 00 00 00 02 0E 00
				15 01 00 00 00 00 02 0F B1
				15 01 00 00 00 00 02 10 00
				15 01 00 00 00 00 02 11 C1
				15 01 00 00 00 00 02 12 00
				15 01 00 00 00 00 02 13 F8
				15 01 00 00 00 00 02 14 01
				15 01 00 00 00 00 02 15 22
				15 01 00 00 00 00 02 16 01
				15 01 00 00 00 00 02 17 5E
				15 01 00 00 00 00 02 18 01
				15 01 00 00 00 00 02 19 8A
				15 01 00 00 00 00 02 1A 01
				15 01 00 00 00 00 02 1B CC
				15 01 00 00 00 00 02 1C 01
				15 01 00 00 00 00 02 1D FD
				15 01 00 00 00 00 02 1E 01
				15 01 00 00 00 00 02 1F FF
				15 01 00 00 00 00 02 20 02
				15 01 00 00 00 00 02 21 2E
				15 01 00 00 00 00 02 22 02
				15 01 00 00 00 00 02 23 66
				15 01 00 00 00 00 02 24 02
				15 01 00 00 00 00 02 25 8D
				15 01 00 00 00 00 02 26 02
				15 01 00 00 00 00 02 27 C4
				15 01 00 00 00 00 02 28 02
				15 01 00 00 00 00 02 29 E9
				15 01 00 00 00 00 02 2A 03
				15 01 00 00 00 00 02 2B 1A
				15 01 00 00 00 00 02 2C 03
				15 01 00 00 00 00 02 2D 28
				15 01 00 00 00 00 02 2E 03
				15 01 00 00 00 00 02 2F 39
				15 01 00 00 00 00 02 30 03
				15 01 00 00 00 00 02 31 4C
				15 01 00 00 00 00 02 32 03
				15 01 00 00 00 00 02 33 62
				15 01 00 00 00 00 02 34 03
				15 01 00 00 00 00 02 35 7A
				15 01 00 00 00 00 02 36 03
				15 01 00 00 00 00 02 37 A1
				15 01 00 00 00 00 02 38 03
				15 01 00 00 00 00 02 39 CF
				15 01 00 00 00 00 02 3A 03
				15 01 00 00 00 00 02 3B E6
				15 01 00 00 00 00 02 3C 00
				15 01 00 00 00 00 02 3D 00
				15 01 00 00 00 00 02 3E 00
				15 01 00 00 00 00 02 3F 16
				15 01 00 00 00 00 02 40 00
				15 01 00 00 00 00 02 41 3B
				15 01 00 00 00 00 02 42 00
				15 01 00 00 00 00 02 43 59
				15 01 00 00 00 00 02 44 00
				15 01 00 00 00 00 02 45 74
				15 01 00 00 00 00 02 46 00
				15 01 00 00 00 00 02 47 8A
				15 01 00 00 00 00 02 48 00
				15 01 00 00 00 00 02 49 9F
				15 01 00 00 00 00 02 4A 00
				15 01 00 00 00 00 02 4B B1
				15 01 00 00 00 00 02 4C 00
				15 01 00 00 00 00 02 4D C1
				15 01 00 00 00 00 02 4E 00
				15 01 00 00 00 00 02 4F F8
				15 01 00 00 00 00 02 50 01
				15 01 00 00 00 00 02 51 22
				15 01 00 00 00 00 02 52 01
				15 01 00 00 00 00 02 53 5E
				15 01 00 00 00 00 02 54 01
				15 01 00 00 00 00 02 55 8A
				15 01 00 00 00 00 02 56 01
				15 01 00 00 00 00 02 57 CC
				15 01 00 00 00 00 02 58 01
				15 01 00 00 00 00 02 59 FD
				15 01 00 00 00 00 02 5A 01
				15 01 00 00 00 00 02 5B FF
				15 01 00 00 00 00 02 5C 02
				15 01 00 00 00 00 02 5D 2E
				15 01 00 00 00 00 02 5E 02
				15 01 00 00 00 00 02 5F 66
				15 01 00 00 00 00 02 60 02
				15 01 00 00 00 00 02 61 8D
				15 01 00 00 00 00 02 62 02
				15 01 00 00 00 00 02 63 C4
				15 01 00 00 00 00 02 64 02
				15 01 00 00 00 00 02 65 E9
				15 01 00 00 00 00 02 66 03
				15 01 00 00 00 00 02 67 1A
				15 01 00 00 00 00 02 68 03
				15 01 00 00 00 00 02 69 28
				15 01 00 00 00 00 02 6A 03
				15 01 00 00 00 00 02 6B 39
				15 01 00 00 00 00 02 6C 03
				15 01 00 00 00 00 02 6D 4C
				15 01 00 00 00 00 02 6E 03
				15 01 00 00 00 00 02 6F 62
				15 01 00 00 00 00 02 70 03
				15 01 00 00 00 00 02 71 7A
				15 01 00 00 00 00 02 72 03
				15 01 00 00 00 00 02 73 A1
				15 01 00 00 00 00 02 74 03
				15 01 00 00 00 00 02 75 CF
				15 01 00 00 00 00 02 76 03
				15 01 00 00 00 00 02 77 E6
				15 01 00 00 00 00 02 78 01
				15 01 00 00 00 00 02 79 01
				39 01 00 00 00 00 04 FF 78 07 03
				15 01 00 00 00 00 02 00 00
				15 01 00 00 00 00 02 01 00
				15 01 00 00 00 00 02 02 00
				15 01 00 00 00 00 02 03 17
				15 01 00 00 00 00 02 04 00
				15 01 00 00 00 00 02 05 3D
				15 01 00 00 00 00 02 06 00
				15 01 00 00 00 00 02 07 5C
				15 01 00 00 00 00 02 08 00
				15 01 00 00 00 00 02 09 76
				15 01 00 00 00 00 02 0A 00
				15 01 00 00 00 00 02 0B 8E
				15 01 00 00 00 00 02 0C 00
				15 01 00 00 00 00 02 0D A2
				15 01 00 00 00 00 02 0E 00
				15 01 00 00 00 00 02 0F B4
				15 01 00 00 00 00 02 10 00
				15 01 00 00 00 00 02 11 C5
				15 01 00 00 00 00 02 12 00
				15 01 00 00 00 00 02 13 FB
				15 01 00 00 00 00 02 14 01
				15 01 00 00 00 00 02 15 24
				15 01 00 00 00 00 02 16 01
				15 01 00 00 00 00 02 17 60
				15 01 00 00 00 00 02 18 01
				15 01 00 00 00 00 02 19 8C
				15 01 00 00 00 00 02 1A 01
				15 01 00 00 00 00 02 1B CD
				15 01 00 00 00 00 02 1C 01
				15 01 00 00 00 00 02 1D FE
				15 01 00 00 00 00 02 1E 02
				15 01 00 00 00 00 02 1F 00
				15 01 00 00 00 00 02 20 02
				15 01 00 00 00 00 02 21 2E
				15 01 00 00 00 00 02 22 02
				15 01 00 00 00 00 02 23 66
				15 01 00 00 00 00 02 24 02
				15 01 00 00 00 00 02 25 8D
				15 01 00 00 00 00 02 26 02
				15 01 00 00 00 00 02 27 C4
				15 01 00 00 00 00 02 28 02
				15 01 00 00 00 00 02 29 E9
				15 01 00 00 00 00 02 2A 03
				15 01 00 00 00 00 02 2B 1B
				15 01 00 00 00 00 02 2C 03
				15 01 00 00 00 00 02 2D 29
				15 01 00 00 00 00 02 2E 03
				15 01 00 00 00 00 02 2F 3A
				15 01 00 00 00 00 02 30 03
				15 01 00 00 00 00 02 31 4D
				15 01 00 00 00 00 02 32 03
				15 01 00 00 00 00 02 33 62
				15 01 00 00 00 00 02 34 03
				15 01 00 00 00 00 02 35 7C
				15 01 00 00 00 00 02 36 03
				15 01 00 00 00 00 02 37 A2
				15 01 00 00 00 00 02 38 03
				15 01 00 00 00 00 02 39 CF
				15 01 00 00 00 00 02 3A 03
				15 01 00 00 00 00 02 3B E6
				15 01 00 00 00 00 02 3C 00
				15 01 00 00 00 00 02 3D 00
				15 01 00 00 00 00 02 3E 00
				15 01 00 00 00 00 02 3F 17
				15 01 00 00 00 00 02 40 00
				15 01 00 00 00 00 02 41 3D
				15 01 00 00 00 00 02 42 00
				15 01 00 00 00 00 02 43 5C
				15 01 00 00 00 00 02 44 00
				15 01 00 00 00 00 02 45 76
				15 01 00 00 00 00 02 46 00
				15 01 00 00 00 00 02 47 8E
				15 01 00 00 00 00 02 48 00
				15 01 00 00 00 00 02 49 A2
				15 01 00 00 00 00 02 4A 00
				15 01 00 00 00 00 02 4B B4
				15 01 00 00 00 00 02 4C 00
				15 01 00 00 00 00 02 4D C5
				15 01 00 00 00 00 02 4E 00
				15 01 00 00 00 00 02 4F FB
				15 01 00 00 00 00 02 50 01
				15 01 00 00 00 00 02 51 24
				15 01 00 00 00 00 02 52 01
				15 01 00 00 00 00 02 53 60
				15 01 00 00 00 00 02 54 01
				15 01 00 00 00 00 02 55 8C
				15 01 00 00 00 00 02 56 01
				15 01 00 00 00 00 02 57 CD
				15 01 00 00 00 00 02 58 01
				15 01 00 00 00 00 02 59 FE
				15 01 00 00 00 00 02 5A 02
				15 01 00 00 00 00 02 5B 00
				15 01 00 00 00 00 02 5C 02
				15 01 00 00 00 00 02 5D 2E
				15 01 00 00 00 00 02 5E 02
				15 01 00 00 00 00 02 5F 66
				15 01 00 00 00 00 02 60 02
				15 01 00 00 00 00 02 61 8D
				15 01 00 00 00 00 02 62 02
				15 01 00 00 00 00 02 63 C4
				15 01 00 00 00 00 02 64 02
				15 01 00 00 00 00 02 65 E9
				15 01 00 00 00 00 02 66 03
				15 01 00 00 00 00 02 67 1B
				15 01 00 00 00 00 02 68 03
				15 01 00 00 00 00 02 69 29
				15 01 00 00 00 00 02 6A 03
				15 01 00 00 00 00 02 6B 3A
				15 01 00 00 00 00 02 6C 03
				15 01 00 00 00 00 02 6D 4D
				15 01 00 00 00 00 02 6E 03
				15 01 00 00 00 00 02 6F 62
				15 01 00 00 00 00 02 70 03
				15 01 00 00 00 00 02 71 7C
				15 01 00 00 00 00 02 72 03
				15 01 00 00 00 00 02 73 A2
				15 01 00 00 00 00 02 74 03
				15 01 00 00 00 00 02 75 CF
				15 01 00 00 00 00 02 76 03
				15 01 00 00 00 00 02 77 E6
				15 01 00 00 00 00 02 78 01
				15 01 00 00 00 00 02 79 01
				39 01 00 00 00 00 04 FF 78 07 04
				15 01 00 00 00 00 02 00 00
				15 01 00 00 00 00 02 01 00
				15 01 00 00 00 00 02 02 00
				15 01 00 00 00 00 02 03 1D
				15 01 00 00 00 00 02 04 00
				15 01 00 00 00 00 02 05 4A
				15 01 00 00 00 00 02 06 00
				15 01 00 00 00 00 02 07 6C
				15 01 00 00 00 00 02 08 00
				15 01 00 00 00 00 02 09 87
				15 01 00 00 00 00 02 0A 00
				15 01 00 00 00 00 02 0B 9F
				15 01 00 00 00 00 02 0C 00
				15 01 00 00 00 00 02 0D B4
				15 01 00 00 00 00 02 0E 00
				15 01 00 00 00 00 02 0F C6
				15 01 00 00 00 00 02 10 00
				15 01 00 00 00 00 02 11 D6
				15 01 00 00 00 00 02 12 01
				15 01 00 00 00 00 02 13 0A
				15 01 00 00 00 00 02 14 01
				15 01 00 00 00 00 02 15 31
				15 01 00 00 00 00 02 16 01
				15 01 00 00 00 00 02 17 6B
				15 01 00 00 00 00 02 18 01
				15 01 00 00 00 00 02 19 95
				15 01 00 00 00 00 02 1A 01
				15 01 00 00 00 00 02 1B D3
				15 01 00 00 00 00 02 1C 02
				15 01 00 00 00 00 02 1D 03
				15 01 00 00 00 00 02 1E 02
				15 01 00 00 00 00 02 1F 04
				15 01 00 00 00 00 02 20 02
				15 01 00 00 00 00 02 21 32
				15 01 00 00 00 00 02 22 02
				15 01 00 00 00 00 02 23 6A
				15 01 00 00 00 00 02 24 02
				15 01 00 00 00 00 02 25 91
				15 01 00 00 00 00 02 26 02
				15 01 00 00 00 00 02 27 C9
				15 01 00 00 00 00 02 28 02
				15 01 00 00 00 00 02 29 F1
				15 01 00 00 00 00 02 2A 03
				15 01 00 00 00 00 02 2B 2C
				15 01 00 00 00 00 02 2C 03
				15 01 00 00 00 00 02 2D 42
				15 01 00 00 00 00 02 2E 03
				15 01 00 00 00 00 02 2F 51
				15 01 00 00 00 00 02 30 03
				15 01 00 00 00 00 02 31 62
				15 01 00 00 00 00 02 32 03
				15 01 00 00 00 00 02 33 76
				15 01 00 00 00 00 02 34 03
				15 01 00 00 00 00 02 35 8D
				15 01 00 00 00 00 02 36 03
				15 01 00 00 00 00 02 37 AE
				15 01 00 00 00 00 02 38 03
				15 01 00 00 00 00 02 39 D3
				15 01 00 00 00 00 02 3A 03
				15 01 00 00 00 00 02 3B E6
				15 01 00 00 00 00 02 3C 00
				15 01 00 00 00 00 02 3D 00
				15 01 00 00 00 00 02 3E 00
				15 01 00 00 00 00 02 3F 1D
				15 01 00 00 00 00 02 40 00
				15 01 00 00 00 00 02 41 4A
				15 01 00 00 00 00 02 42 00
				15 01 00 00 00 00 02 43 6C
				15 01 00 00 00 00 02 44 00
				15 01 00 00 00 00 02 45 87
				15 01 00 00 00 00 02 46 00
				15 01 00 00 00 00 02 47 9F
				15 01 00 00 00 00 02 48 00
				15 01 00 00 00 00 02 49 B4
				15 01 00 00 00 00 02 4A 00
				15 01 00 00 00 00 02 4B C6
				15 01 00 00 00 00 02 4C 00
				15 01 00 00 00 00 02 4D D6
				15 01 00 00 00 00 02 4E 01
				15 01 00 00 00 00 02 4F 0A
				15 01 00 00 00 00 02 50 01
				15 01 00 00 00 00 02 51 31
				15 01 00 00 00 00 02 52 01
				15 01 00 00 00 00 02 53 6B
				15 01 00 00 00 00 02 54 01
				15 01 00 00 00 00 02 55 95
				15 01 00 00 00 00 02 56 01
				15 01 00 00 00 00 02 57 D3
				15 01 00 00 00 00 02 58 02
				15 01 00 00 00 00 02 59 03
				15 01 00 00 00 00 02 5A 02
				15 01 00 00 00 00 02 5B 04
				15 01 00 00 00 00 02 5C 02
				15 01 00 00 00 00 02 5D 32
				15 01 00 00 00 00 02 5E 02
				15 01 00 00 00 00 02 5F 6A
				15 01 00 00 00 00 02 60 02
				15 01 00 00 00 00 02 61 91
				15 01 00 00 00 00 02 62 02
				15 01 00 00 00 00 02 63 C9
				15 01 00 00 00 00 02 64 02
				15 01 00 00 00 00 02 65 F1
				15 01 00 00 00 00 02 66 03
				15 01 00 00 00 00 02 67 2C
				15 01 00 00 00 00 02 68 03
				15 01 00 00 00 00 02 69 42
				15 01 00 00 00 00 02 6A 03
				15 01 00 00 00 00 02 6B 51
				15 01 00 00 00 00 02 6C 03
				15 01 00 00 00 00 02 6D 62
				15 01 00 00 00 00 02 6E 03
				15 01 00 00 00 00 02 6F 76
				15 01 00 00 00 00 02 70 03
				15 01 00 00 00 00 02 71 8D
				15 01 00 00 00 00 02 72 03
				15 01 00 00 00 00 02 73 AE
				15 01 00 00 00 00 02 74 03
				15 01 00 00 00 00 02 75 D3
				15 01 00 00 00 00 02 76 03
				15 01 00 00 00 00 02 77 E6
				15 01 00 00 00 00 02 78 01
				15 01 00 00 00 00 02 79 01
				39 01 00 00 00 00 04 FF 78 07 00
				05 01 00 00 00 00 02 11 00
				05 01 00 00 78 00 02 35 00
				05 01 00 00 0A 00 02 29 00];
		qcom,mdss-dsi-off-command = [05 01 00 00 32 00 02 28 00
					05 01 00 00 78 00 02 10 00];
		qcom,mdss-dsi-on-command-state = "dsi_lp_mode";
		qcom,mdss-dsi-off-command-state = "dsi_hs_mode";
		qcom,mdss-dsi-h-sync-pulse = <1>;
		qcom,mdss-dsi-traffic-mode = "burst_mode";
		qcom,mdss-dsi-lane-map = "lane_map_0123";
		qcom,mdss-dsi-bllp-eof-power-mode;
		qcom,mdss-dsi-bllp-power-mode;
		qcom,mdss-dsi-lane-0-state;
		qcom,mdss-dsi-lane-1-state;
		qcom,mdss-dsi-lane-2-state;
		qcom,mdss-dsi-lane-3-state;
		qcom,mdss-dsi-panel-timings = [7D 24 19 00 34 31 1D 26 2A 03 04 00];
		qcom,mdss-dsi-t-clk-post = <0x1F>;
		qcom,mdss-dsi-t-clk-pre = <0x2C>;
		qcom,mdss-dsi-bl-min-level = <1>;
		qcom,mdss-dsi-bl-max-level = <4095>;
		qcom,mdss-dsi-dma-trigger = "trigger_sw";
		qcom,mdss-dsi-mdp-trigger = "none";
		qcom,mdss-dsi-bl-pmic-control-type = "bl_ctrl_wled";
		qcom,mdss-dsi-reset-sequence = <1 20>, <0 20>, <1 20>;
	};
};
