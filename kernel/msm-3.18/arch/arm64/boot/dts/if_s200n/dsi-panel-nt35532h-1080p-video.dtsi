/* Copyright (c) 2013, The Linux Foundation. All rights reserved.
 *
 * This program is free software; you can redistribute it and/or modify
 * it under the terms of the GNU General Public License version 2 and
 * only version 2 as published by the Free Software Foundation.
 *
 * This program is distributed in the hope that it will be useful,
 * but WITHOUT ANY WARRANTY; without even the implied warranty of
 * MERCHANTABILITY or FITNESS FOR A PARTICULAR PURPOSE.  See the
 * GNU General Public License for more details.
 */

/*---------------------------------------------------------------------------
 * This file is autogenerated file using gcdb parser. Please do not edit it.
 * Update input XML file to add a new entry or update variable in this file
 * VERSION = "1.0"
 *---------------------------------------------------------------------------*/
&mdss_mdp {
	dsi_nt35532h_1080p_video: qcom,mdss_dsi_nt35532h_1080p_video {
		qcom,mdss-dsi-panel-name = "nt35532h 1080p video mode dsi panel";
		qcom,mdss-dsi-panel-controller = <&mdss_dsi0>;
		qcom,mdss-dsi-panel-type = "dsi_video_mode";
		qcom,mdss-dsi-panel-destination = "display_1";
		qcom,mdss-dsi-panel-framerate = <60>;
		qcom,mdss-dsi-virtual-channel-id = <0>;
		qcom,mdss-dsi-stream = <0>;
		qcom,mdss-dsi-panel-width = <1080>;
		qcom,mdss-dsi-panel-height = <1920>;
		qcom,mdss-dsi-h-front-porch = <100>;
		qcom,mdss-dsi-h-back-porch = <100>;
		qcom,mdss-dsi-h-pulse-width = <4>;
		qcom,mdss-dsi-h-sync-skew = <0>;
		qcom,mdss-dsi-v-back-porch = <10>;
		qcom,mdss-dsi-v-front-porch = <16>;
		qcom,mdss-dsi-v-pulse-width = <2>;
		qcom,mdss-dsi-h-left-border = <0>;
		qcom,mdss-dsi-h-right-border = <0>;
		qcom,mdss-dsi-v-top-border = <0>;
		qcom,mdss-dsi-v-bottom-border = <0>;
		qcom,mdss-dsi-bpp = <24>;
		qcom,mdss-dsi-color-order = "rgb_swap_rgb";
		qcom,mdss-dsi-underflow-color = <0xff>;
		qcom,mdss-dsi-border-color = <0>;
		qcom,mdss-dsi-on-command = [15 01 00 00 00 00 02 FF 01
			15 01 00 00 00 00 02 FB 01
			15 01 00 00 00 00 02 00 01
			15 01 00 00 00 00 02 01 55
			15 01 00 00 00 00 02 02 59
			15 01 00 00 00 00 02 04 0C
			15 01 00 00 00 00 02 05 3A
			15 01 00 00 00 00 02 06 55
			15 01 00 00 00 00 02 07 D5
			15 01 00 00 00 00 02 0D 9D
			15 01 00 00 00 00 02 0E 9D
			15 01 00 00 00 00 02 0F E0
			15 01 00 00 00 00 02 10 03
			15 01 00 00 00 00 02 11 3C
			15 01 00 00 00 00 02 12 50
			15 01 00 00 00 00 02 13 70
			15 01 00 00 00 00 02 14 70
			15 01 00 00 00 00 02 15 60
			15 01 00 00 00 00 02 16 14
			15 01 00 00 00 00 02 17 14
			15 01 00 00 00 00 02 44 68
			15 01 00 00 00 00 02 45 88
			15 01 00 00 00 00 02 46 78
			15 01 00 00 00 00 02 6D 33
			15 01 00 00 00 00 02 68 13
			15 01 00 00 00 00 02 75 00
			15 01 00 00 00 00 02 76 01
			15 01 00 00 00 00 02 77 00
			15 01 00 00 00 00 02 78 4F
			15 01 00 00 00 00 02 79 00
			15 01 00 00 00 00 02 7A 7F
			15 01 00 00 00 00 02 7B 00
			15 01 00 00 00 00 02 7C 9E
			15 01 00 00 00 00 02 7D 00
			15 01 00 00 00 00 02 7E B6
			15 01 00 00 00 00 02 7F 00
			15 01 00 00 00 00 02 80 C9
			15 01 00 00 00 00 02 81 00
			15 01 00 00 00 00 02 82 DB
			15 01 00 00 00 00 02 83 00
			15 01 00 00 00 00 02 84 EB
			15 01 00 00 00 00 02 85 00
			15 01 00 00 00 00 02 86 F9
			15 01 00 00 00 00 02 87 01
			15 01 00 00 00 00 02 88 27
			15 01 00 00 00 00 02 89 01
			15 01 00 00 00 00 02 8A 4C
			15 01 00 00 00 00 02 8B 01
			15 01 00 00 00 00 02 8C 86
			15 01 00 00 00 00 02 8D 01
			15 01 00 00 00 00 02 8E B4
			15 01 00 00 00 00 02 8F 01
			15 01 00 00 00 00 02 90 F9
			15 01 00 00 00 00 02 91 02
			15 01 00 00 00 00 02 92 2F
			15 01 00 00 00 00 02 93 02
			15 01 00 00 00 00 02 94 30
			15 01 00 00 00 00 02 95 02
			15 01 00 00 00 00 02 96 61
			15 01 00 00 00 00 02 97 02
			15 01 00 00 00 00 02 98 97
			15 01 00 00 00 00 02 99 02
			15 01 00 00 00 00 02 9A B9
			15 01 00 00 00 00 02 9B 02
			15 01 00 00 00 00 02 9C EB
			15 01 00 00 00 00 02 9D 03
			15 01 00 00 00 00 02 9E 0F
			15 01 00 00 00 00 02 9F 03
			15 01 00 00 00 00 02 A0 3C
			15 01 00 00 00 00 02 A2 03
			15 01 00 00 00 00 02 A3 4A
			15 01 00 00 00 00 02 A4 03
			15 01 00 00 00 00 02 A5 59
			15 01 00 00 00 00 02 A6 03
			15 01 00 00 00 00 02 A7 6C
			15 01 00 00 00 00 02 A9 03
			15 01 00 00 00 00 02 AA 87
			15 01 00 00 00 00 02 AB 03
			15 01 00 00 00 00 02 AC AA
			15 01 00 00 00 00 02 AD 03
			15 01 00 00 00 00 02 AE C3
			15 01 00 00 00 00 02 AF 03
			15 01 00 00 00 00 02 B0 CC
			15 01 00 00 00 00 02 B1 03
			15 01 00 00 00 00 02 B2 CD
			15 01 00 00 00 00 02 B3 00
			15 01 00 00 00 00 02 B4 01
			15 01 00 00 00 00 02 B5 00
			15 01 00 00 00 00 02 B6 4F
			15 01 00 00 00 00 02 B7 00
			15 01 00 00 00 00 02 B8 7F
			15 01 00 00 00 00 02 B9 00
			15 01 00 00 00 00 02 BA 9E
			15 01 00 00 00 00 02 BB 00
			15 01 00 00 00 00 02 BC B6
			15 01 00 00 00 00 02 BD 00
			15 01 00 00 00 00 02 BE C9
			15 01 00 00 00 00 02 BF 00
			15 01 00 00 00 00 02 C0 DB
			15 01 00 00 00 00 02 C1 00
			15 01 00 00 00 00 02 C2 EB
			15 01 00 00 00 00 02 C3 00
			15 01 00 00 00 00 02 C4 F9
			15 01 00 00 00 00 02 C5 01
			15 01 00 00 00 00 02 C6 27
			15 01 00 00 00 00 02 C7 01
			15 01 00 00 00 00 02 C8 4C
			15 01 00 00 00 00 02 C9 01
			15 01 00 00 00 00 02 CA 86
			15 01 00 00 00 00 02 CB 01
			15 01 00 00 00 00 02 CC B4
			15 01 00 00 00 00 02 CD 01
			15 01 00 00 00 00 02 CE F9
			15 01 00 00 00 00 02 CF 02
			15 01 00 00 00 00 02 D0 2F
			15 01 00 00 00 00 02 D1 02
			15 01 00 00 00 00 02 D2 30
			15 01 00 00 00 00 02 D3 02
			15 01 00 00 00 00 02 D4 61
			15 01 00 00 00 00 02 D5 02
			15 01 00 00 00 00 02 D6 97
			15 01 00 00 00 00 02 D7 02
			15 01 00 00 00 00 02 D8 B9
			15 01 00 00 00 00 02 D9 02
			15 01 00 00 00 00 02 DA EB
			15 01 00 00 00 00 02 DB 03
			15 01 00 00 00 00 02 DC 0F
			15 01 00 00 00 00 02 DD 03
			15 01 00 00 00 00 02 DE 3C
			15 01 00 00 00 00 02 DF 03
			15 01 00 00 00 00 02 E0 4A
			15 01 00 00 00 00 02 E1 03
			15 01 00 00 00 00 02 E2 59
			15 01 00 00 00 00 02 E3 03
			15 01 00 00 00 00 02 E4 6C
			15 01 00 00 00 00 02 E5 03
			15 01 00 00 00 00 02 E6 87
			15 01 00 00 00 00 02 E7 03
			15 01 00 00 00 00 02 E8 AA
			15 01 00 00 00 00 02 E9 03
			15 01 00 00 00 00 02 EA C3
			15 01 00 00 00 00 02 EB 03
			15 01 00 00 00 00 02 EC CC
			15 01 00 00 00 00 02 ED 03
			15 01 00 00 00 00 02 EE CD
			15 01 00 00 00 00 02 EF 00
			15 01 00 00 00 00 02 F0 F1
			15 01 00 00 00 00 02 F1 00
			15 01 00 00 00 00 02 F2 F7
			15 01 00 00 00 00 02 F3 01
			15 01 00 00 00 00 02 F4 04
			15 01 00 00 00 00 02 F5 01
			15 01 00 00 00 00 02 F6 0F
			15 01 00 00 00 00 02 F7 01
			15 01 00 00 00 00 02 F8 19
			15 01 00 00 00 00 02 F9 01
			15 01 00 00 00 00 02 FA 23
			15 01 00 00 00 00 02 FF 02
			15 01 00 00 00 00 02 FB 01
			15 01 00 00 00 00 02 00 01
			15 01 00 00 00 00 02 01 2D
			15 01 00 00 00 00 02 02 01
			15 01 00 00 00 00 02 03 37
			15 01 00 00 00 00 02 04 01
			15 01 00 00 00 00 02 05 3F
			15 01 00 00 00 00 02 06 01
			15 01 00 00 00 00 02 07 5E
			15 01 00 00 00 00 02 08 01
			15 01 00 00 00 00 02 09 79
			15 01 00 00 00 00 02 0A 01
			15 01 00 00 00 00 02 0B A7
			15 01 00 00 00 00 02 0C 01
			15 01 00 00 00 00 02 0D CC
			15 01 00 00 00 00 02 0E 02
			15 01 00 00 00 00 02 0F 08
			15 01 00 00 00 00 02 10 02
			15 01 00 00 00 00 02 11 39
			15 01 00 00 00 00 02 12 02
			15 01 00 00 00 00 02 13 3A
			15 01 00 00 00 00 02 14 02
			15 01 00 00 00 00 02 15 69
			15 01 00 00 00 00 02 16 02
			15 01 00 00 00 00 02 17 9D
			15 01 00 00 00 00 02 18 02
			15 01 00 00 00 00 02 19 C0
			15 01 00 00 00 00 02 1A 02
			15 01 00 00 00 00 02 1B F3
			15 01 00 00 00 00 02 1C 03
			15 01 00 00 00 00 02 1D 16
			15 01 00 00 00 00 02 1E 03
			15 01 00 00 00 00 02 1F 44
			15 01 00 00 00 00 02 20 03
			15 01 00 00 00 00 02 21 53
			15 01 00 00 00 00 02 22 03
			15 01 00 00 00 00 02 23 64
			15 01 00 00 00 00 02 24 03
			15 01 00 00 00 00 02 25 7A
			15 01 00 00 00 00 02 26 03
			15 01 00 00 00 00 02 27 95
			15 01 00 00 00 00 02 28 03
			15 01 00 00 00 00 02 15 B0
			15 01 00 00 00 00 02 2A 03
			15 01 00 00 00 00 02 2B C3
			15 01 00 00 00 00 02 2D 03
			15 01 00 00 00 00 02 2F CC
			15 01 00 00 00 00 02 30 03
			15 01 00 00 00 00 02 31 CD
			15 01 00 00 00 00 02 32 00
			15 01 00 00 00 00 02 33 F1
			15 01 00 00 00 00 02 34 00
			15 01 00 00 00 00 02 35 F7
			15 01 00 00 00 00 02 36 01
			15 01 00 00 00 00 02 37 04
			15 01 00 00 00 00 02 38 01
			15 01 00 00 00 00 02 39 0F
			15 01 00 00 00 00 02 3A 01
			15 01 00 00 00 00 02 3B 19
			15 01 00 00 00 00 02 3D 01
			15 01 00 00 00 00 02 3F 23
			15 01 00 00 00 00 02 40 01
			15 01 00 00 00 00 02 41 2D
			15 01 00 00 00 00 02 42 01
			15 01 00 00 00 00 02 43 37
			15 01 00 00 00 00 02 44 01
			15 01 00 00 00 00 02 45 3F
			15 01 00 00 00 00 02 46 01
			15 01 00 00 00 00 02 47 5E
			15 01 00 00 00 00 02 48 01
			15 01 00 00 00 00 02 49 79
			15 01 00 00 00 00 02 4A 01
			15 01 00 00 00 00 02 4B A7
			15 01 00 00 00 00 02 4C 01
			15 01 00 00 00 00 02 4D CC
			15 01 00 00 00 00 02 4E 02
			15 01 00 00 00 00 02 4F 08
			15 01 00 00 00 00 02 50 02
			15 01 00 00 00 00 02 51 39
			15 01 00 00 00 00 02 52 02
			15 01 00 00 00 00 02 53 3A
			15 01 00 00 00 00 02 54 02
			15 01 00 00 00 00 02 55 69
			15 01 00 00 00 00 02 56 02
			15 01 00 00 00 00 02 58 9D
			15 01 00 00 00 00 02 59 02
			15 01 00 00 00 00 02 5A C0
			15 01 00 00 00 00 02 5B 02
			15 01 00 00 00 00 02 5C F3
			15 01 00 00 00 00 02 5D 03
			15 01 00 00 00 00 02 5E 16
			15 01 00 00 00 00 02 5F 03
			15 01 00 00 00 00 02 60 44
			15 01 00 00 00 00 02 61 03
			15 01 00 00 00 00 02 62 53
			15 01 00 00 00 00 02 63 03
			15 01 00 00 00 00 02 64 64
			15 01 00 00 00 00 02 65 03
			15 01 00 00 00 00 02 66 7A
			15 01 00 00 00 00 02 67 03
			15 01 00 00 00 00 02 68 95
			15 01 00 00 00 00 02 69 03
			15 01 00 00 00 00 02 6A B0
			15 01 00 00 00 00 02 6B 03
			15 01 00 00 00 00 02 6C C3
			15 01 00 00 00 00 02 6D 03
			15 01 00 00 00 00 02 6E CC
			15 01 00 00 00 00 02 6F 03
			15 01 00 00 00 00 02 70 CD
			15 01 00 00 00 00 02 71 00
			15 01 00 00 00 00 02 72 A9
			15 01 00 00 00 00 02 73 00
			15 01 00 00 00 00 02 74 B3
			15 01 00 00 00 00 02 75 00
			15 01 00 00 00 00 02 76 C6
			15 01 00 00 00 00 02 77 00
			15 01 00 00 00 00 02 78 D6
			15 01 00 00 00 00 02 79 00
			15 01 00 00 00 00 02 7A E4
			15 01 00 00 00 00 02 7B 00
			15 01 00 00 00 00 02 7C F1
			15 01 00 00 00 00 02 7D 00
			15 01 00 00 00 00 02 7E FE
			15 01 00 00 00 00 02 7F 01
			15 01 00 00 00 00 02 80 0B
			15 01 00 00 00 00 02 81 01
			15 01 00 00 00 00 02 82 15
			15 01 00 00 00 00 02 83 01
			15 01 00 00 00 00 02 84 3B
			15 01 00 00 00 00 02 85 01
			15 01 00 00 00 00 02 86 5B
			15 01 00 00 00 00 02 87 01
			15 01 00 00 00 00 02 88 8F
			15 01 00 00 00 00 02 89 01
			15 01 00 00 00 00 02 8A B9
			15 01 00 00 00 00 02 8B 01
			15 01 00 00 00 00 02 8C FB
			15 01 00 00 00 00 02 8D 02
			15 01 00 00 00 00 02 8E 30
			15 01 00 00 00 00 02 8F 02
			15 01 00 00 00 00 02 90 31
			15 01 00 00 00 00 02 91 02
			15 01 00 00 00 00 02 92 62
			15 01 00 00 00 00 02 93 02
			15 01 00 00 00 00 02 94 98
			15 01 00 00 00 00 02 95 02
			15 01 00 00 00 00 02 96 BB
			15 01 00 00 00 00 02 97 02
			15 01 00 00 00 00 02 98 F0
			15 01 00 00 00 00 02 99 03
			15 01 00 00 00 00 02 9A 17
			15 01 00 00 00 00 02 9B 03
			15 01 00 00 00 00 02 9C 52
			15 01 00 00 00 00 02 9D 03
			15 01 00 00 00 00 02 9E 6C
			15 01 00 00 00 00 02 9F 03
			15 01 00 00 00 00 02 A0 97
			15 01 00 00 00 00 02 A2 03
			15 01 00 00 00 00 02 A3 B6
			15 01 00 00 00 00 02 A4 03
			15 01 00 00 00 00 02 A5 BF
			15 01 00 00 00 00 02 A6 03
			15 01 00 00 00 00 02 A7 C2
			15 01 00 00 00 00 02 A9 03
			15 01 00 00 00 00 02 AA C7
			15 01 00 00 00 00 02 AB 03
			15 01 00 00 00 00 02 AC CC
			15 01 00 00 00 00 02 AD 03
			15 01 00 00 00 00 02 AE CD
			15 01 00 00 00 00 02 AF 00
			15 01 00 00 00 00 02 B0 A9
			15 01 00 00 00 00 02 B1 00
			15 01 00 00 00 00 02 B2 B3
			15 01 00 00 00 00 02 B3 00
			15 01 00 00 00 00 02 B4 C6
			15 01 00 00 00 00 02 B5 00
			15 01 00 00 00 00 02 B6 D6
			15 01 00 00 00 00 02 B7 00
			15 01 00 00 00 00 02 B8 E4
			15 01 00 00 00 00 02 B9 00
			15 01 00 00 00 00 02 BA F1
			15 01 00 00 00 00 02 BB 00
			15 01 00 00 00 00 02 BC FE
			15 01 00 00 00 00 02 BD 01
			15 01 00 00 00 00 02 BE 0B
			15 01 00 00 00 00 02 BF 01
			15 01 00 00 00 00 02 C0 15
			15 01 00 00 00 00 02 C1 01
			15 01 00 00 00 00 02 C2 3B
			15 01 00 00 00 00 02 C3 01
			15 01 00 00 00 00 02 C4 5B
			15 01 00 00 00 00 02 C5 01
			15 01 00 00 00 00 02 C6 8F
			15 01 00 00 00 00 02 C7 01
			15 01 00 00 00 00 02 C8 B9
			15 01 00 00 00 00 02 C9 01
			15 01 00 00 00 00 02 CA FB
			15 01 00 00 00 00 02 CB 02
			15 01 00 00 00 00 02 CC 30
			15 01 00 00 00 00 02 CD 02
			15 01 00 00 00 00 02 CE 31
			15 01 00 00 00 00 02 CF 02
			15 01 00 00 00 00 02 D0 62
			15 01 00 00 00 00 02 D1 02
			15 01 00 00 00 00 02 D2 98
			15 01 00 00 00 00 02 D3 02
			15 01 00 00 00 00 02 D4 BB
			15 01 00 00 00 00 02 D5 02
			15 01 00 00 00 00 02 D6 F0
			15 01 00 00 00 00 02 D7 03
			15 01 00 00 00 00 02 D8 17
			15 01 00 00 00 00 02 D9 03
			15 01 00 00 00 00 02 DA 52
			15 01 00 00 00 00 02 DB 03
			15 01 00 00 00 00 02 DC 6C
			15 01 00 00 00 00 02 DD 03
			15 01 00 00 00 00 02 DE 97
			15 01 00 00 00 00 02 DF 03
			15 01 00 00 00 00 02 E0 B6
			15 01 00 00 00 00 02 E1 03
			15 01 00 00 00 00 02 E2 BF
			15 01 00 00 00 00 02 E3 03
			15 01 00 00 00 00 02 E4 C2
			15 01 00 00 00 00 02 E5 03
			15 01 00 00 00 00 02 E6 C7
			15 01 00 00 00 00 02 E7 03
			15 01 00 00 00 00 02 E8 CC
			15 01 00 00 00 00 02 E9 03
			15 01 00 00 00 00 02 EA CD
			15 01 00 00 00 00 02 FF 05
			15 01 00 00 00 00 02 00 35
			15 01 00 00 00 00 02 01 08
			15 01 00 00 00 00 02 02 06
			15 01 00 00 00 00 02 03 04
			15 01 00 00 00 00 02 04 34
			15 01 00 00 00 00 02 05 1A
			15 01 00 00 00 00 02 06 1A
			15 01 00 00 00 00 02 07 16
			15 01 00 00 00 00 02 08 16
			15 01 00 00 00 00 02 09 22
			15 01 00 00 00 00 02 0A 22
			15 01 00 00 00 00 02 0B 1E
			15 01 00 00 00 00 02 0C 1E
			15 01 00 00 00 00 02 0D 05
			15 01 00 00 00 00 02 0E 40
			15 01 00 00 00 00 02 0F 40
			15 01 00 00 00 00 02 10 40
			15 01 00 00 00 00 02 11 40
			15 01 00 00 00 00 02 12 40
			15 01 00 00 00 00 02 13 40
			15 01 00 00 00 00 02 14 35
			15 01 00 00 00 00 02 15 09
			15 01 00 00 00 00 02 16 07
			15 01 00 00 00 00 02 17 04
			15 01 00 00 00 00 02 18 34
			15 01 00 00 00 00 02 19 1C
			15 01 00 00 00 00 02 1A 1C
			15 01 00 00 00 00 02 1B 18
			15 01 00 00 00 00 02 1C 18
			15 01 00 00 00 00 02 1D 24
			15 01 00 00 00 00 02 1E 24
			15 01 00 00 00 00 02 1F 20
			15 01 00 00 00 00 02 20 20
			15 01 00 00 00 00 02 21 05
			15 01 00 00 00 00 02 22 40
			15 01 00 00 00 00 02 23 40
			15 01 00 00 00 00 02 24 40
			15 01 00 00 00 00 02 25 40
			15 01 00 00 00 00 02 26 40
			15 01 00 00 00 00 02 27 40
			15 01 00 00 00 00 02 28 35
			15 01 00 00 00 00 02 15 07
			15 01 00 00 00 00 02 2A 09
			15 01 00 00 00 00 02 2B 04
			15 01 00 00 00 00 02 2D 34
			15 01 00 00 00 00 02 2F 20
			15 01 00 00 00 00 02 30 20
			15 01 00 00 00 00 02 31 24
			15 01 00 00 00 00 02 32 24
			15 01 00 00 00 00 02 33 18
			15 01 00 00 00 00 02 34 18
			15 01 00 00 00 00 02 35 1C
			15 01 00 00 00 00 02 36 1C
			15 01 00 00 00 00 02 37 05
			15 01 00 00 00 00 02 38 40
			15 01 00 00 00 00 02 39 40
			15 01 00 00 00 00 02 3A 40
			15 01 00 00 00 00 02 3B 40
			15 01 00 00 00 00 02 3D 40
			15 01 00 00 00 00 02 3F 40
			15 01 00 00 00 00 02 40 35
			15 01 00 00 00 00 02 41 06
			15 01 00 00 00 00 02 42 08
			15 01 00 00 00 00 02 43 04
			15 01 00 00 00 00 02 44 34
			15 01 00 00 00 00 02 45 1E
			15 01 00 00 00 00 02 46 1E
			15 01 00 00 00 00 02 47 22
			15 01 00 00 00 00 02 48 22
			15 01 00 00 00 00 02 49 16
			15 01 00 00 00 00 02 4A 16
			15 01 00 00 00 00 02 4B 1A
			15 01 00 00 00 00 02 4C 1A
			15 01 00 00 00 00 02 4D 05
			15 01 00 00 00 00 02 4E 40
			15 01 00 00 00 00 02 4F 40
			15 01 00 00 00 00 02 50 40
			15 01 00 00 00 00 02 51 40
			15 01 00 00 00 00 02 52 40
			15 01 00 00 00 00 02 53 40
			15 01 00 00 00 00 02 54 08
			15 01 00 00 00 00 02 55 06
			15 01 00 00 00 00 02 56 08
			15 01 00 00 00 00 02 58 06
			15 01 00 00 00 00 02 59 1B
			15 01 00 00 00 00 02 5A 1B
			15 01 00 00 00 00 02 5B 48
			15 01 00 00 00 00 02 5C 0E
			15 01 00 00 00 00 02 5D 01
			15 01 00 00 00 00 02 65 00
			15 01 00 00 00 00 02 66 44
			15 01 00 00 00 00 02 67 00
			15 01 00 00 00 00 02 68 48
			15 01 00 00 00 00 02 69 0E
			15 01 00 00 00 00 02 6A 06
			15 01 00 00 00 00 02 6B 20
			15 01 00 00 00 00 02 6C 08
			15 01 00 00 00 00 02 6D 00
			15 01 00 00 00 00 02 76 00
			15 01 00 00 00 00 02 77 00
			15 01 00 00 00 00 02 78 02
			15 01 00 00 00 00 02 79 00
			15 01 00 00 00 00 02 7A 0A
			15 01 00 00 00 00 02 7B 05
			15 01 00 00 00 00 02 7C 00
			15 01 00 00 00 00 02 7D 0D
			15 01 00 00 00 00 02 7E 33
			15 01 00 00 00 00 02 7F 33
			15 01 00 00 00 00 02 80 33
			15 01 00 00 00 00 02 81 00
			15 01 00 00 00 00 02 82 00
			15 01 00 00 00 00 02 83 00
			15 01 00 00 00 00 02 84 30
			15 01 00 00 00 00 02 85 FF
			15 01 00 00 00 00 02 86 FF
			15 01 00 00 00 00 02 BB 88
			15 01 00 00 00 00 02 B7 FF
			15 01 00 00 00 00 02 B8 00
			15 01 00 00 00 00 02 BA 13
			15 01 00 00 00 00 02 BC 95
			15 01 00 00 00 00 02 BD AA
			15 01 00 00 00 00 02 BE 08
			15 01 00 00 00 00 02 BF A3
			15 01 00 00 00 00 02 C8 00
			15 01 00 00 00 00 02 C9 00
			15 01 00 00 00 00 02 CA 00
			15 01 00 00 00 00 02 CB 00
			15 01 00 00 00 00 02 CC 12
			15 01 00 00 96 00 02 CF 44
			15 01 00 00 00 00 02 D0 00
			15 01 00 00 00 00 02 D1 00
			15 01 00 00 00 00 02 D4 15
			15 01 00 00 00 00 02 D5 BF
			15 01 00 00 00 00 02 90 78
			15 01 00 00 00 00 02 91 10
			15 01 00 00 00 00 02 92 10
			15 01 00 00 00 00 02 97 08
			15 01 00 00 00 00 02 98 00
			15 01 00 00 00 00 02 99 00
			15 01 00 00 00 00 02 9B 68
			15 01 00 00 00 00 02 9C 0A
			15 01 00 00 96 00 02 FF 00
			15 01 00 00 00 00 02 36 00
			15 01 00 00 00 00 02 D3 0E
			15 01 00 00 00 00 02 D4 0A
			15 01 00 00 00 00 02 D5 0A
			15 01 00 00 00 00 02 D6 14
			15 01 00 00 00 00 02 35 01
			05 01 00 00 32 00 02 11 00
			05 01 00 00 78 00 02 29 00];
		qcom,mdss-dsi-off-command = [05 01 00 00 32 00 02 28 00
					05 01 00 00 78 00 02 10 00];
		qcom,mdss-dsi-on-command-state = "dsi_lp_mode";
		qcom,mdss-dsi-off-command-state = "dsi_hs_mode";
		qcom,mdss-dsi-h-sync-pulse = <1>;
		qcom,mdss-dsi-traffic-mode = "burst_mode";
		qcom,mdss-dsi-lane-map = "lane_map_0123";
		qcom,mdss-dsi-bllp-eof-power-mode;
		qcom,mdss-dsi-bllp-power-mode;
		qcom,mdss-dsi-lane-0-state;
		qcom,mdss-dsi-lane-1-state;
		qcom,mdss-dsi-lane-2-state;
		qcom,mdss-dsi-lane-3-state;
		qcom,mdss-dsi-panel-timings = [d6 38 26 00 6a 6c 2c 3c 2c 03 04 00];
		qcom,mdss-dsi-t-clk-post = <0x02>;
		qcom,mdss-dsi-t-clk-pre = <0x29>;
		qcom,mdss-dsi-bl-min-level = <1>;
		qcom,mdss-dsi-bl-max-level = <4095>;
		qcom,mdss-dsi-dma-trigger = "trigger_sw";
		qcom,mdss-dsi-mdp-trigger = "none";
		qcom,mdss-dsi-bl-pmic-control-type = "bl_ctrl_wled";
		qcom,mdss-dsi-reset-sequence = <1 20>, <0 2>, <1 20>;
	};
};
